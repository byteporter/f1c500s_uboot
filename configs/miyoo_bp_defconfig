## configs/miyoo_bp_defconfig
```kconfig
CONFIG_ARM=y
CONFIG_ARCH_SUNXI=y
CONFIG_CONS_INDEX=2
CONFIG_IDENT_STRING=" Allwinner Technology Pocket-Go BytePorter"
CONFIG_MACH_SUNIV=y
CONFIG_DRAM_CLK=156
CONFIG_DRAM_ZQ=0
# CONFIG_VIDEO_SUNXI is not set
CONFIG_DEFAULT_DEVICE_TREE="suniv-f1c500s-miyoo-pwm-17000"
CONFIG_PRE_CON_BUF_ADDR=0x81d00000
CONFIG_SPL=y
CONFIG_SYS_MMCSD_RAW_MODE_U_BOOT_SECTOR=0x80
# CONFIG_SPL_DM_SERIAL is not set
```
